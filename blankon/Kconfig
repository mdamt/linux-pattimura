## blankon/Kconfig
```kconfig
menu "BlankOn Supplied Third-Party Device Drivers"

source "blankon/aufs/Kconfig"
##
##
##

endmenu
```

## ubuntu/Kconfig
```kconfig
menu "Ubuntu Supplied Third-Party Device Drivers"

source "ubuntu/aufs/Kconfig"
##
##
##

endmenu
```
